## boards/shields/saver/Kconfig.shield
```kconfig
# Copyright (c) 2020 Ryan Cross
# SPDX-License-Identifier: MIT

config SHIELD_SAVER_LEFT
    def_bool $(shields_list_contains,saver_left)

config SHIELD_SAVER_RIGHT
    def_bool $(shields_list_contains,saver_right)
```
