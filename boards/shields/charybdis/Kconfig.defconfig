## boards/shields/charybdis/Kconfig.defconfig
```kconfig
# Copyright (c) 2020 Ryan Cross
# SPDX-License-Identifier: MIT

if SHIELD_CHARYBDIS_RIGHT

config ZMK_KEYBOARD_NAME
    default "Charybdis"

config ZMK_SPLIT_ROLE_CENTRAL
    default y

endif

if SHIELD_CHARYBDIS_LEFT || SHIELD_CHARYBDIS_RIGHT

config ZMK_SPLIT
    default y

if ZMK_RGB_UNDERGLOW

config WS2812_STRIP
    default y
endif

endif
```

## boards/shields/charybdis/Kconfig.shield
```kconfig
# Copyright (c) 2020 Ryan Cross
# SPDX-License-Identifier: MIT

config SHIELD_CHARYBDIS_LEFT
    def_bool $(shields_list_contains,tp-sofle_left)

config SHIELD_CHARYBDIS_RIGHT
    def_bool $(shields_list_contains,tp-sofle_right)
```

## boards/shields/tp-sofle/Kconfig.shield
```kconfig
# Copyright (c) 2020 Ryan Cross
# SPDX-License-Identifier: MIT

config SHIELD_TP_SOFLE_LEFT
    def_bool $(shields_list_contains,tp-sofle_left)

config SHIELD_TP_SOFLE_RIGHT
    def_bool $(shields_list_contains,tp-sofle_right)
```
