/*
 * Central (XIAO) user overrides, layered on top of
 * boards/shields/tp-sofle/tp-sofle_central.overlay.
 */

#include <input/processors.dtsi>
#include <dt-bindings/zmk/input_transform.h>

/ {
  trackball_listener {
    // Both axes inverted (up <-> down, left <-> right), then the auto-mouse
    // layer as before. The LOWER-layer scroller override replaces these base
    // processors, so scrolling is unaffected.
    input-processors = <&zip_xy_transform (INPUT_TRANSFORM_X_INVERT | INPUT_TRANSFORM_Y_INVERT)>, <&zip_temp_layer 4 500>;
  };
};
